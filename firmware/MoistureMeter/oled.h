// Minimal buffer-less SSD1306 128x64 I2C driver (text only, scalable 5x7 font).
// Draws straight to display RAM, so no 1 KB frame buffer is needed (ATtiny1614 has 2 KB SRAM).
#pragma once
#include <Arduino.h>
#include <Wire.h>
#include <avr/pgmspace.h>

#define OLED_ADDR 0x3C

// 5x7 font, ASCII 0x20..0x5A, column-major, bit 0 = top row
static const uint8_t FONT[] PROGMEM = {
  0x00,0x00,0x00,0x00,0x00, 0x00,0x00,0x5F,0x00,0x00, 0x00,0x07,0x00,0x07,0x00, 0x14,0x7F,0x14,0x7F,0x14, // ' ' ! " #
  0x24,0x2A,0x7F,0x2A,0x12, 0x23,0x13,0x08,0x64,0x62, 0x36,0x49,0x56,0x20,0x50, 0x00,0x00,0x07,0x00,0x00, // $ % & '
  0x00,0x1C,0x22,0x41,0x00, 0x00,0x41,0x22,0x1C,0x00, 0x2A,0x1C,0x7F,0x1C,0x2A, 0x08,0x08,0x3E,0x08,0x08, // ( ) * +
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  0x63,0x14,0x08,0x14,0x63, 0x07,0x08,0x70,0x08,0x07, 0x61,0x51,0x49,0x45,0x43                            // X Y Z
};

static uint8_t oledSent;
static void dataBegin() { Wire.beginTransmission(OLED_ADDR); Wire.write(0x40); oledSent = 0; }
static void dataByte(uint8_t b) {
  if (oledSent == 16) { Wire.endTransmission(); dataBegin(); }   // stay well inside the Wire buffer
  Wire.write(b); oledSent++;
}
static void dataEnd() { Wire.endTransmission(); }

static void oledCmd(const uint8_t *c, uint8_t n) {
  Wire.beginTransmission(OLED_ADDR);
  Wire.write(0x00);
  while (n--) Wire.write(*c++);
  Wire.endTransmission();
}
static inline void oledCmd1(uint8_t c) { oledCmd(&c, 1); }

static void oledWindow(uint8_t x0, uint8_t x1, uint8_t p0, uint8_t p1) {
  uint8_t c[] = {0x21, x0, x1, 0x22, p0, p1};
  oledCmd(c, sizeof c);
}

static void oledClearPages(uint8_t p0, uint8_t p1) {
  oledWindow(0, 127, p0, p1);
  dataBegin();
  for (uint16_t n = 128u * (p1 - p0 + 1); n; n--) dataByte(0);
  dataEnd();
}
static void oledClear() { oledClearPages(0, 7); }

// Returns false if the display does not ACK (not connected / not powered).
static bool oledInit() {
  static const uint8_t init[] PROGMEM = {
    0xAE, 0xD5, 0x80, 0xA8, 0x3F, 0xD3, 0x00, 0x40, 0x8D, 0x14,   // off, clock, mux, offset, start line, charge pump on
    0x20, 0x00, 0xA1, 0xC8, 0xDA, 0x12, 0x81, 0x8F, 0xD9, 0xF1,   // horizontal addressing, remap, COM cfg, contrast, precharge
    0xDB, 0x40, 0xA4, 0xA6};
  uint8_t buf[sizeof init];
  memcpy_P(buf, init, sizeof init);
  Wire.beginTransmission(OLED_ADDR);
  if (Wire.endTransmission() != 0) return false;
  oledCmd(buf, 12);
  oledCmd(buf + 12, sizeof init - 12);
  oledClear();
  oledCmd1(0xAF);
  return true;
}

static void oledOff() { oledCmd1(0xAE); }

// One character at column x, page p, scale s (1..4). Cell is 6*s wide, 8*s tall.
static void oledChar(uint8_t x, uint8_t p, char ch, uint8_t s) {
  if (ch >= 'a' && ch <= 'z') ch -= 32;
  if (ch < 0x20 || ch > 0x5A) ch = '?';
  const uint8_t *g = FONT + (ch - 0x20) * 5;
  for (uint8_t k = 0; k < s; k++) {
    oledWindow(x, x + 6 * s - 1, p + k, p + k);
    dataBegin();
    for (uint8_t c = 0; c < 6; c++) {
      uint8_t src = c < 5 ? pgm_read_byte(g + c) : 0, out = 0;
      for (uint8_t j = 0; j < 8; j++)
        if (src & (1 << ((k * 8 + j) / s))) out |= 1 << j;
      for (uint8_t r = 0; r < s; r++) dataByte(out);
    }
    dataEnd();
  }
}

static void oledText(uint8_t x, uint8_t p, const char *t, uint8_t s = 1) {
  while (*t && x <= 128 - 6 * s) { oledChar(x, p, *t++, s); x += 6 * s; }
}

// Clears the text's pages, then draws it centered.
static void oledLine(uint8_t p, const char *t, uint8_t s = 1) {
  oledClearPages(p, p + s - 1);
  uint8_t w = strlen(t) * 6 * s;
  oledText(w < 128 ? (128 - w) / 2 : 0, p, t, s);
}

// Framed horizontal bar graph on one page.
static void oledBar(uint8_t p, uint8_t pct) {
  uint8_t fill = 2 + (uint16_t)pct * 124 / 100;
  oledWindow(0, 127, p, p);
  dataBegin();
  for (uint8_t x = 0; x < 128; x++)
    dataByte((x == 0 || x == 127 || x < fill) ? 0x7E : 0x42);
  dataEnd();
}
